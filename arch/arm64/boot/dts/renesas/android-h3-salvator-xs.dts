/*
 * Device Tree Source for the Salvator-XS 2nd version board with R-Car H3 ES2.0
 * Android specific extensions
 *
 * Copyright (C) 2018 GlobalLogic
 *
 * This file is licensed under the terms of the GNU General Public License
 * version 2.  This program is licensed "as is" without any warranty of any
 * kind, whether express or implied.
 */

/dts-v1/;
#include "r8a7795-salvator-xs.dts"
#include "android-h3.dtsi"
#include "android-salvator.dtsi"
