/*
 * Device Tree Source for the Salvator-X 2nd version board with R-Car M3-N
 * Android specific extensions
 *
 * Copyright (C) 2018 GlobalLogic
 *
 * This file is licensed under the terms of the GNU General Public License
 * version 2.  This program is licensed "as is" without any warranty of any
 * kind, whether express or implied.
 */

/dts-v1/;
#include "r8a77965-salvator-xs.dts"
#include "android/salvator.dtsi"
#include "android/r8a77965.dtsi"
