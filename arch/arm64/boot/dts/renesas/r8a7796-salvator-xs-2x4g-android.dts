/*
 * Device Tree Source for the Salvator-XS 2nd version board with R-Car M3 ES3.0
 * Android specific extensions
 *
 * Copyright (C) 2019 GlobalLogic
 *
 * This file is licensed under the terms of the GNU General Public License
 * version 2.  This program is licensed "as is" without any warranty of any
 * kind, whether express or implied.
 */

/dts-v1/;
#include "r8a7796-salvator-xs-2x4g.dts"
#include "android/r8a7796.dtsi"
#include "android/salvator.dtsi"
