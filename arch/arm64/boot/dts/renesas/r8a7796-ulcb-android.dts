/*
 * Device Tree Source for the M3ULCB (R-Car Starter Kit Pro) board
 * Android specific extensions
 *
 * Copyright (C) 2020 GlobalLogic
 *
 * This file is licensed under the terms of the GNU General Public License
 * version 2.  This program is licensed "as is" without any warranty of any
 * kind, whether express or implied.
 */

#ifndef __M3ULCB_OVERWRITE__
#include "r8a7796-m3ulcb.dts"
#endif // __M3ULCB_OVERWRITE__
#include "android/r8a7796.dtsi"
#include "ulcb-android.dtsi"

