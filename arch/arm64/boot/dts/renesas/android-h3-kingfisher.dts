/*
 * Device Tree Source for the H3ULCB Kingfisher board
 * Android specific extensions
 *
 * Copyright (C) 2018 GlobalLogic
 *
 * This file is licensed under the terms of the GNU General Public License
 * version 2.  This program is licensed "as is" without any warranty of any
 * kind, whether express or implied.
 */

/dts-v1/;
#define __H3ULCB_OVERWRITE__
#include "r8a7795-h3ulcb-kf.dts"
#include "android-h3ulcb.dts"
#include "android-kingfisher.dtsi"
