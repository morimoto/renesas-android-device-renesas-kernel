/*
 * Device Tree Source for the Salvator-XS 2nd version board with R-Car H3 ES2.0
 * Android specific extensions
 *
 * Copyright (C) 2018 GlobalLogic
 *
 * This file is licensed under the terms of the GNU General Public License
 * version 2.  This program is licensed "as is" without any warranty of any
 * kind, whether express or implied.
 */

#include "r8a7795-salvator-xs-2x2g.dts"
#define __H3_SALVATOR_XS_OVERRIDE__
#include "android-h3-salvator-xs.dts"
