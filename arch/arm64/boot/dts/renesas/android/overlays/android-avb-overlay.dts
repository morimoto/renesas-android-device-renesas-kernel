/*
 * Device Tree Source for the Android
 *
 * Copyright (C) 2019 GlobalLogic
 *
 * This file is licensed under the terms of the GNU General Public License
 * version 2.  This program is licensed "as is" without any warranty of any
 * kind, whether express or implied.
 */
/dts-v1/;
/plugin/;

&android {
    vbmeta {
        compatible = "android,vbmeta";
        parts = "vbmeta,boot,vendor_boot,dtbo";
    };
};
