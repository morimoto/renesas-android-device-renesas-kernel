/*
 * Device Tree Source for the Android
 *
 * Copyright (C) 2020 GlobalLogic
 *
 * This file is licensed under the terms of the GNU General Public License
 * version 2. This program is licensed "as is" without any warranty of any
 * kind, whether express or implied.
 */

/dts-v1/;
/plugin/;

#define CPG_MOD	1

&du {
	reg = <0 0xfeb00000 0 0x80000>,
		 <0 0xfea40000 0 0x00001000>,
		 <0 0xfea50000 0 0x00001000>,
		 <0 0xfea70000 0 0x00001000>;
	reg-names = "du", "cmm.0", "cmm.1", "cmm.3";

	clocks = <&cpg CPG_MOD 724>,
		 <&cpg CPG_MOD 723>,
		 <&cpg CPG_MOD 721>,
		 <&cpg CPG_MOD 711>,
		 <&cpg CPG_MOD 710>,
		 <&cpg CPG_MOD 708>,
		 <&versaclock5_6 1>,
		 <&x21_clk>,
		 <&versaclock5_6 2>;
	clock-names = "du.0", "du.1", "du.3",
		 "cmm.0", "cmm.1", "cmm.3",
		 "dclkin.0", "dclkin.1", "dclkin.3";

	resets = <&cpg 724>,
		 <&cpg 724>,
		 <&cpg 722>,
		 <&cpg 711>,
		 <&cpg 710>,
		 <&cpg 708>;
	reset-names = "du.0", "du.1", "du.3",
		 "cmm.0", "cmm.1", "cmm.3";
};