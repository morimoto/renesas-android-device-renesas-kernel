/*
 * Device Tree Source for the H3ULCB Kingfisher board with R-Car H3 ES2.0+ with 8GiB
 *
 * Copyright (C) 2018 Renesas Electronics Corp.
 *
 * This file is licensed under the terms of the GNU General Public License
 * version 2.  This program is licensed "as is" without any warranty of any
 * kind, whether express or implied.
 */

/dts-v1/;
/plugin/;

/{
  fragment_root {
    target-path = "/";
    __overlay__ {
		model = "Renesas H3ULCB Kingfisher board based on r8a7795 ES3.0+ with 8GiB (4x2 GiB)";
    };
  };
};
