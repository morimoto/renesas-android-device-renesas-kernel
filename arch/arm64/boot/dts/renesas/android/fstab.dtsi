/*
 * Device Tree Source for the Android
 *
 * Copyright (C) 2017 GlobalLogic
 *
 * This file is licensed under the terms of the GNU General Public License
 * version 2.  This program is licensed "as is" without any warranty of any
 * kind, whether express or implied.
 */

/ {
    firmware {

        optee {
            compatible = "linaro,optee-tz";
            method = "smc";
        };

        android: android {
            compatible = "android,firmware";
        };
    };
};
